## main/Kconfig
```kconfig
menu "Example Test"

config TEST_WIFI_SSID
    string "Wi-Fi SSID"
    default "your_wifi_ssid"

config TEST_WIFI_PASS
    string "Wi-Fi Password"
    default "your_wifi_password"

config TEST_SERVER_URL
    string "HTTP/HTTPS Server URL"
    default "http://192.168.1.100:8000/pcm"

endmenu
```
